## Kconfig
```kconfig
if $(RTOS_PATH) != ""
    source "$(RTOS_PATH)/arch/Kconfig"
    source "$(RTOS_PATH)/config/toolchains/Kconfig"
    source "$(RTOS_PATH)/boards/Kconfig"
endif

if $(PROJECT_DIR) != ""
    source "$(PROJECT_DIR)/Kconfig"
endif
```

## arch/Kconfig
```kconfig
config ARCH
    string
    default "$(RTOS_PATH)/arch/aarch64" if BOARD_QEMU_VIRT_AARCH64
    default "$(RTOS_PATH)/arch/i686"   if BOARD_QEMU_I686
    default "$(RTOS_PATH)/arch/xtensa" if BOARD_ESP32_S3
    default "$(RTOS_PATH)/arch/aarch64" if BOARD_RASPBERRYPI_4B
```

## boards/Kconfig
```kconfig
choice
    prompt "Select Target Board"
    default BOARD_QEMU_VIRT_AARCH64

config BOARD_QEMU_VIRT_AARCH64
    bool "QEMU virt aarch64 cortex-a53"
    help
      Runs the RTOS on aarch64 QEMU virtual machine.

config BOARD_QEMU_I686
    bool "QEMU i686 PC"
    help
      Runs the RTOS on x86 i686 QEMU virtual machine.

config BOARD_ESP32_S3
    bool "ESP32-S3 DevKit"
    help
      Runs the RTOS on the ESP32-S3 microcontroller.

config BOARD_RASPBERRYPI_4B
    bool "Raspberry Pi 4B"
    help
      Runs the RTOS on Raspberry Pi 4 Model B.

endchoice

config LINKER_SCRIPT 
    string
    default "boards/qemu_virt/linker.ld"   if BOARD_QEMU_VIRT_AARCH64
    default "qemu_i686"   if BOARD_QEMU_I686
    default "esp32_s3"    if BOARD_ESP32_S3
    default "raspberrypi_4b" if BOARD_RASPBERRYPI_4B
```

## config/toolchains/Kconfig
```kconfig
config TOOLCHAIN_FILE
    string
    default "$(RTOS_PATH)/config/toolchains/aarch64-none-elf.mk" if BOARD_QEMU_VIRT_AARCH64
    default "$(RTOS_PATH)/config/toolchains/native-gcc"        if BOARD_QEMU_I686
    default "$(RTOS_PATH)/config/toolchains/xtensa-esp32-elf"  if BOARD_ESP32_S3
    default "$(RTOS_PATH)/config/toolchains/aarch64-linux-gnu" if BOARD_RASPBERRYPI_4B
```

## examples/Kconfig
```kconfig
menu "Example apps"

config HELLO_WORLD
    bool "Configure Hello World app"

if HELLO_WORLD 
    source "examples/hello_world/Kconfig"
endif

endmenu
```

## examples/hello_world/Kconfig
```kconfig
menu "Hello World Configuration"

config HELLO_WORLD_MESSAGE 
    string "Message to print"
    default "Hello World"
    help
        Message to be displayed. 


endmenu
```
